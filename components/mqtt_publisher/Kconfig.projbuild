## components/mqtt_publisher/Kconfig.projbuild
```kconfig
menu "MQTT Configuration"

config MQTT_BROKER_URI
    string "MQTT Broker URI"
    default "mqtt://192.168.1.100:1883"
    help
        URI of the MQTT broker (e.g., mqtt://192.168.1.100:1883)

config MQTT_USERNAME
    string "MQTT Username"
    default "esp32"
    help
        Username for the MQTT broker authentication

config MQTT_PASSWORD
    string "MQTT Password"
    default "esp_pass"
    help
        Password for the MQTT broker authentication

endmenu
```

## components/wifi_manager/Kconfig.projbuild
```kconfig
menu "Wifi Configuration"

config WIFI_SSID
    string "WiFi SSID"
    default "ssid"
    help
	SSID (network name) for the example to connect to.

config WIFI_PASSWORD
    string "WiFi Password"
    default "password"
    help
	WiFi password (WPA or WPA2) for the example to use.

endmenu
```
